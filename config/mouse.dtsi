#define ZMK_MOUSE_DEFAULT_MOVE_VAL 3000  // 1500 puis 2000
#define ZMK_MOUSE_DEFAULT_SCRL_VAL 20    // 20

#include <dt-bindings/zmk/mouse.h>
#include <behaviors/mouse_keys.dtsi>

&mmv {
    acceleration-exponent = <1>;      // 1
    time-to-max-speed-ms = <500>;     // 300
    delay-ms = <0>;                   // 0
};

&msc {
    acceleration-exponent = <1>;      // 0
    time-to-max-speed-ms = <100>;      // 2000
    delay-ms = <0>;                   // 0
};
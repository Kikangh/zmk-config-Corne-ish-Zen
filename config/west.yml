## config/west.yml
```yaml
manifest:
  remotes:
    - name: zmkfirmware
      url-base: https://github.com/LOWPROKB
    - name: kikangh
      url-base: https://github.com/Kikangh
  projects:
    - name: zmk
      remote: kikangh
      revision: 2024-Mouse-Zen-Display-from-Cem
      import: app/west.yml
  self:
    path: config
```
